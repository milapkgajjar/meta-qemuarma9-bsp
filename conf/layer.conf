## conf/layer.conf
```bitbake
# We have a conf and classes directory, add to BBPATH
BBPATH .= ":${LAYERDIR}"

# We have recipes-* directories, add to BBFILES
BBFILES += "${LAYERDIR}/recipes-*/*/*.bb \
            ${LAYERDIR}/recipes-*/*/*.bbappend"

BBFILE_COLLECTIONS += "meta-aeiou-qemuarma9"
BBFILE_PATTERN_meta-aeiou-qemuarma9 = "^${LAYERDIR}/"
BBFILE_PRIORITY_meta-aeiou-qemuarma9 = "6"

LAYERDEPENDS_meta-aeiou-qemuarma9 = "core"
LAYERSERIES_COMPAT_meta-aeiou-qemuarma9 = "kirkstone"
```

## conf/machine/qemuarma9.conf
```bitbake
#@TYPE: Machine
#@NAME: qemuarma9
#@DESCRIPTION: a9 vexpress

# Configuring the hardware target

# Include the qemu
require conf/machine/include/qemu.inc

# Defines tunes for the CPU in the SoC
require conf/machine/include/arm/armv7a/tune-cortexa9.inc
DEFAULTTUNE ?= "armv7at"

# Basic info about the hardware
SERIAL_CONSOLES ?= "115200;ttyAMA0 115200;ttyAMA1"

# Select kernel recipe, set parameters for kernel build
PREFERRED_PROVIDER_virtual/kernel ?= "linux-yocto"
PREFERRED_VERSION_linux-yocto ?= "5.15%"

KERNEL_IMAGETYPE = "zImage"
#KERNEL_DEVICETREE = "am335x-bone.dtb am335x-boneblack.dtb am335x-bonegreen.dtb"

# For runqemu
QB_SYSTEM_NAME = "qemu-system-arm"
QB_MACHINE = "-machine vexpress-a9"

QB_MEM = "-m 256"
QB_SERIAL_OPT = "-serial stdio"

QB_OPT_APPEND = "-nographic"
```
